## 2030_SystemInfo/main/Kconfig.projbuild
```kconfig
menu "Example Configuration"

config HELLO_MESSAGE
    string "Display message"
	default "Hello world!"
	help
		Message string to display in loop.
		
config LOOP_DURATION
    int "Loop duration"
	range 100 10000
	default 1000
	help
		Loop duration in milliseconds (100-10,000 msec)

endmenu
```

## 2080_GPIO_Interrupt/main/Kconfig.projbuild
```kconfig
menu "Example Configuration"

config INPUT_GPIO
    int "Input GPIO number"
	range 0 34
	default 5
	help
		GPIO number (IOxx) to input.

		Some GPIOs are used for other purposes (flash connections, etc.) and cannot be used to blink.

		GPIOs 35-39 are input-only so cannot be used as outputs.

endmenu
```

## 2090_DHT/main/Kconfig.projbuild
```kconfig
menu "Example Configuration"

config DHT_GPIO
    int "DHT GPIO number"
	range 0 34
	default 16
	help
		GPIO number (IOxx) to input.

		Some GPIOs are used for other purposes (flash connections, etc.) and cannot be used to blink.

		GPIOs 35-39 are input-only so cannot be used as outputs.

endmenu
```

## 2140_ThingSpeak/main/Kconfig.projbuild
```kconfig
menu "Example Configuration"

config WIFI_SSID
    string "WiFi SSID"
	default "myssid"
	help
		SSID (network name) for the example to connect to.

config WIFI_PASSWORD
    string "WiFi Password"
	default "myssid"
	help
		WiFi password (WPA or WPA2) for the example to use.

		Can be left blank if the network has no security set.

config DHT_GPIO
    int "DHT GPIO number"
	range 0 34
	default 16
	help
		GPIO number (IOxx) to input.

		Some GPIOs are used for other purposes (flash connections, etc.) and cannot be used to blink.

		GPIOs 35-39 are input-only so cannot be used as outputs.
		
endmenu
```
